## meta-lenovo/conf/layer.conf
```bitbake
# We have a conf and classes directory, add to BBPATH
BBPATH .= ":${LAYERDIR}"

# We have recipes-* directories, add to BBFILES
BBFILES += "${LAYERDIR}/recipes-*/*/*.bb \
            ${LAYERDIR}/recipes-*/*/*.bbappend"

BBFILE_COLLECTIONS += "lenovo-layer"
BBFILE_PATTERN_lenovo-layer := "^${LAYERDIR}/"
LAYERVERSION_lenovo-layer = "1"
LAYERSERIES_COMPAT_lenovo-layer = "nanbield scarthgap"
```

## meta-lenovo/conf/machine/include/lenovo.inc
```bitbake
OBMC_MACHINE_FEATURES += "\
        obmc-phosphor-fan-mgmt \
        obmc-phosphor-chassis-mgmt \
        obmc-phosphor-flash-mgmt \
        obmc-host-ipmi \
        obmc-host-state-mgmt \
        obmc-chassis-state-mgmt \
        obmc-bmc-state-mgmt \
        "
```

## meta-lenovo/meta-hr630/conf/layer.conf
```bitbake
# We have a conf and classes directory, add to BBPATH
BBPATH .= ":${LAYERDIR}"

# We have recipes-* directories, add to BBFILES
BBFILES += "${LAYERDIR}/recipes-*/*/*.bb \
            ${LAYERDIR}/recipes-*/*/*.bbappend"

BBFILE_COLLECTIONS += "hr630-layer"
BBFILE_PATTERN_hr630-layer := "^${LAYERDIR}/"
LAYERSERIES_COMPAT_hr630-layer = "nanbield scarthgap"
```

## meta-lenovo/meta-hr630/conf/machine/hr630.conf
```bitbake
KMACHINE = "aspeed"
KERNEL_DEVICETREE = "aspeed/${KMACHINE}-bmc-lenovo-${MACHINE}.dtb"

UBOOT_DEVICETREE = "ast2500-evb"
UBOOT_MACHINE = "evb-ast2500_defconfig"

FLASH_SIZE = "32768"

require conf/machine/include/ast2500.inc
require conf/machine/include/obmc-bsp-common.inc
require conf/machine/include/lenovo.inc

VIRTUAL-RUNTIME_obmc-host-state-manager = "x86-power-control"
VIRTUAL-RUNTIME_obmc-chassis-state-manager = "x86-power-control"
VIRTUAL-RUNTIME_obmc-discover-system-state = "x86-power-control"
VIRTUAL-RUNTIME_obmc-inventory-manager = "entity-manager"

PREFERRED_PROVIDER_virtual/obmc-host-ipmi-hw = "phosphor-ipmi-kcs"
PREFERRED_PROVIDER_virtual/phosphor-led-manager-config-native = "hr630-led-manager-config-native"
PREFERRED_PROVIDER_virtual/obmc-chassis-mgmt = "packagegroup-hr630-apps"
PREFERRED_PROVIDER_virtual/obmc-fan-mgmt = "packagegroup-hr630-apps"
PREFERRED_PROVIDER_virtual/obmc-flash-mgmt = "packagegroup-hr630-apps"
PREFERRED_PROVIDER_virtual/obmc-system-mgmt = "packagegroup-hr630-apps"
PREFERRED_PROVIDER_virtual/obmc-inventory-data = "entity-manager"
```
