## meta-asrock/meta-altrad8/conf/machine/altrad8.conf
```bitbake
KMACHINE = "aspeed"
KERNEL_DEVICETREE = "aspeed/${KMACHINE}-bmc-asrock-${MACHINE}.dtb"

UBOOT_MACHINE = "evb-ast2500_defconfig"
UBOOT_DEVICETREE = "ast2500-evb"

require conf/machine/include/ast2500.inc
require conf/machine/include/obmc-bsp-common.inc
require conf/distro/include/phosphor-aspeed-spi-master-mode.inc
require conf/distro/include/phosphor-production.inc

DISTRO_FEATURES:append = " security"

DISTRO_FEATURES:remove = "slp avahi"

# Reformat SPI flash layout to 64MB
FLASH_SIZE = "65536"

OBMC_CHASSIS_INSTANCES = "0"
OBMC_HOST_INSTANCES = "0"

MACHINE_FEATURES += "\
        obmc-phosphor-chassis-mgmt \
        obmc-phosphor-flash-mgmt \
        obmc-phosphor-fan-mgmt \
        obmc-chassis-state-mgmt \
        obmc-host-state-mgmt \
        obmc-bmc-state-mgmt \
        obmc-host-ipmi \
        "

OBMC_COMPATIBLE_NAMES = "com.asrockrack.Hardware.Chassis.Model.ALTRAD8"

OBMC_IMAGE_EXTRA_INSTALL:append = "\
                                   phosphor-ipmi-blobs \
                                   phosphor-ipmi-blobs-binarystore \
                                   ampere-platform-init \
                                   ampere-utils \
                                   ac01-boot-progress \
                                   ipmitool \
                                   phosphor-pid-control \
                                   mtd-utils \
                                 "

PREFERRED_PROVIDER_virtual/obmc-chassis-mgmt = "packagegroup-ampere-apps"
PREFERRED_PROVIDER_virtual/obmc-system-mgmt = "packagegroup-ampere-apps"
PREFERRED_PROVIDER_virtual/obmc-host-ipmi-hw = "phosphor-ipmi-ssif"
PREFERRED_PROVIDER_virtual/obmc-flash-mgmt = "packagegroup-ampere-apps"

PREFERRED_PROVIDER_virtual/obmc-fan-mgmt = "packagegroup-ampere-apps"

VIRTUAL-RUNTIME_phosphor-ipmi-providers = ""
VIRTUAL-RUNTIME_obmc-sensors-hwmon = "dbus-sensors"
```

## meta-asrock/meta-x470d4u/conf/machine/include/64-spi.inc
```bitbake
FLASH_SIZE = "65536"

# The image always uses a 32M layout
FLASH_UBOOT_OFFSET:flash-65536 = "0"
FLASH_UBOOT_ENV_OFFSET:flash-65536 = "384"
FLASH_KERNEL_OFFSET:flash-65536 = "512"
FLASH_ROFS_OFFSET:flash-65536 = "4864"
FLASH_RWFS_OFFSET:flash-65536 = "28672"
```
